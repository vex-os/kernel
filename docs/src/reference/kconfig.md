## kernel/core/Kconfig
```kconfig
config KPRINTF_BUFSIZE
    int "Kernel log buffer size (bytes)"
    range 2048 1048576
    default 65536
    help
      Ring buffer of recent kernel messages at every level,
      replayed to consoles that register or take their
      device back later; a multiple of 8

config DEFAULT_HOSTNAME
    string "Default hostname"
    default "vexsys"
    help
      Name of the machine until sethostname changes it;
      at most 255 bytes

comment "Consoles"

source "kernel/fbcons/Kconfig"

config BXCONS
    bool "Bochs debug port console"
    depends on ARCH_HAS_DEBUGCON
    default y
    help
      Print kernel messages to the debug I/O port, which
      QEMU and Bochs can redirect to a file or stdio

comment "Firmware"

config UACPI_QUIET
    bool "Silence uACPI log messages"
    default y
    help
      Drop the messages uACPI logs while it parses
      and runs the firmware ACPI tables
```

## kernel/fbcons/Kconfig
```kconfig
config FBCONS
    bool "Framebuffer console"
    default y
    help
      Print kernel messages to the first boot framebuffer,
      or to the native driver's that took its memory over

choice FBCONS_FONT
    prompt "Framebuffer console font"
    depends on FBCONS
    default FBCONS_FONT_VEXDEMOS_8X16
    help
      The font in fbcons/fonts that the console draws with.
      Its size is the one in its file name. To add a font,
      put the file there and give it an entry here and a
      line in FBCONS_FONT_FILE

config FBCONS_FONT_VEXDEMOS_8X16
    bool "VexDemos 8x16"
    help
      The hand-drawn font of the project

config FBCONS_FONT_IBM_VGA_8X8
    bool "IBM VGA 8x8"
    help
      Dump of the 8x8 IBM VGA ROM font

config FBCONS_FONT_IBM_VGA_8X14
    bool "IBM VGA 8x14"
    help
      Dump of the 8x14 IBM VGA ROM font

config FBCONS_FONT_IBM_VGA_8X16
    bool "IBM VGA 8x16"
    help
      Dump of the 8x16 IBM VGA ROM font

config FBCONS_FONT_TERMINUS_8X16
    bool "Terminus 8x16"
    help
      256-glyph 8x16 Terminus, OFL-1.1

config FBCONS_FONT_TERMINUS_BOLD_8X16
    bool "Terminus 8x16 Bold"
    help
      256-glyph 8x16 Terminus Bold, OFL-1.1

config FBCONS_FONT_TERMINUS_10X20
    bool "Terminus 10x20"
    help
      256-glyph 10x20 Terminus, OFL-1.1

config FBCONS_FONT_TERMINUS_BOLD_10X20
    bool "Terminus 10x20 Bold"
    help
      256-glyph 10x20 Terminus Bold, OFL-1.1

config FBCONS_FONT_TERMINUS_12X24
    bool "Terminus 12x24"
    help
      256-glyph 12x24 Terminus, OFL-1.1

config FBCONS_FONT_TERMINUS_BOLD_12X24
    bool "Terminus 12x24 Bold"
    help
      256-glyph 12x24 Terminus Bold, OFL-1.1

config FBCONS_FONT_TERMINUS_16X32
    bool "Terminus 16x32"
    help
      256-glyph 16x32 Terminus, OFL-1.1

config FBCONS_FONT_TERMINUS_BOLD_16X32
    bool "Terminus 16x32 Bold"
    help
      256-glyph 16x32 Terminus Bold, OFL-1.1

endchoice

config FBCONS_FONT_FILE
    string
    default "VexDemos_8x16.bin" if FBCONS_FONT_VEXDEMOS_8X16
    default "IBM_VGA_8x8.bin" if FBCONS_FONT_IBM_VGA_8X8
    default "IBM_VGA_8x14.bin" if FBCONS_FONT_IBM_VGA_8X14
    default "IBM_VGA_8x16.bin" if FBCONS_FONT_IBM_VGA_8X16
    default "Terminus_8x16.bin" if FBCONS_FONT_TERMINUS_8X16
    default "TerminusBold_8x16.bin" if FBCONS_FONT_TERMINUS_BOLD_8X16
    default "Terminus_10x20.bin" if FBCONS_FONT_TERMINUS_10X20
    default "TerminusBold_10x20.bin" if FBCONS_FONT_TERMINUS_BOLD_10X20
    default "Terminus_12x24.bin" if FBCONS_FONT_TERMINUS_12X24
    default "TerminusBold_12x24.bin" if FBCONS_FONT_TERMINUS_BOLD_12X24
    default "Terminus_16x32.bin" if FBCONS_FONT_TERMINUS_16X32
    default "TerminusBold_16x32.bin" if FBCONS_FONT_TERMINUS_BOLD_16X32

choice FBCONS_CURSOR
    prompt "Framebuffer console cursor"
    depends on FBCONS
    default FBCONS_CURSOR_INVERT
    help
      The look of the cursor. It sits in the bottom
      left corner of its cell

config FBCONS_CURSOR_INVERT
    bool "Inverted block"
    help
      Swaps the colors of the glyph under the cursor

config FBCONS_CURSOR_OVERLAP
    bool "Overlapping block"
    help
      Fills the cursor over the glyph under it

config FBCONS_CURSOR_FRAME
    bool "Frame"
    help
      Draws a frame of one pixel over the glyph under it

config FBCONS_CURSOR_NONE
    bool "None"

endchoice

config FBCONS_CURSOR_HEIGHT
    int "Cursor height (% of the cell)"
    depends on FBCONS && !FBCONS_CURSOR_NONE
    range 0 100
    default 6 if FBCONS_CURSOR_OVERLAP
    default 100
    help
      A share of the height of the cell, rounded up
      to whole pixels. 0 draws nothing

config FBCONS_CURSOR_WIDTH
    int "Cursor width (% of the cell)"
    depends on FBCONS && !FBCONS_CURSOR_NONE
    range 0 100
    default 100
    help
      A share of the width of the cell, rounded up
      to whole pixels. 0 draws nothing

config FBCONS_TAB_WIDTH
    int "Tab width"
    depends on FBCONS
    range 2 8
    default 4
    help
      Columns between tab stops
```

## kernel/fs/Kconfig
```kconfig
comment "Caching"

config VCACHE_MAX_UNUSED
    int "Unused vnodes kept cached"
    range 0 1048576
    default 1024
    help
      Vnodes that nobody holds stay cached up to this many,
      so looking the same paths up again needs no disk access

config FCACHE_WRITEBACK_MSEC
    int "File cache writeback interval (ms)"
    range 100 600000
    default 5000
    help
      How often dirty file pages and filesystem
      metadata are written back to disk

config FCACHE_DIRTY_PERCENT
    int "Dirty file cache limit (% of memory)"
    range 1 90
    default 20
    help
      A write that finds more of memory dirty than this
      writes its own file back before returning

comment "Access times"

choice
    prompt "Access time updates on read"
    default ATIME_RELATIME
    help
      Whether reading a file or a directory moves its
      access time, which costs an inode write when it does

config ATIME_RELATIME
    bool "relatime"
    help
      Only when the access time is not past the last change,
      or is older than ATIME_RELATIME_INTERVAL; as in Linux

config ATIME_STRICT
    bool "strictatime"
    help
      On every read, as POSIX asks

config ATIME_NONE
    bool "noatime"
    help
      Never; only utimensat and file creation set it

endchoice

config ATIME_RELATIME_INTERVAL
    int "Relatime update interval (s)"
    depends on ATIME_RELATIME
    range 1 31536000
    default 86400
    help
      An access time this much older than now is moved
      even when the file has not changed since

comment "Filesystem types"

config DEVFS
    bool "Device filesystem"
    default y
    help
      Synthetic filesystem with a node for every
      registered block and character device

config ECHFS
    bool "echfs"
    default y
    help
      The simple filesystem made
      alongside the Limine bootloader

config EXT2
    bool "ext2"
    default y
    help
      Second extended filesystem, used for
      the DATA partition of the boot image

config TMPFS
    bool "tmpfs"
    default y
    help
      Files and directories kept in memory, for /tmp and /run.
      The pages of the files count against the commit limit

config FAT
    bool "FAT"
    default y
    help
      FAT12, FAT16 and FAT32 volumes,
      such as the EFI system partition
```
